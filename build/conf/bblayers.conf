## build/conf/bblayers.conf
```bitbake
# POKY_BBLAYERS_CONF_VERSION is increased each time build/conf/bblayers.conf
# changes incompatibly
POKY_BBLAYERS_CONF_VERSION = "2"

BBPATH = "${TOPDIR}"
BBFILES ?= ""

BBLAYERS ?= " \
  /home/build/openembedded-core \
  /home/build/meta-openembedded \
  /home/build/meta-gstreamer1.0 \
  /home/build/meta-webkit \
  "
```
